/*
*
* Copyright (c) 2025 Daniel Suter
* SPDX-License-Identifier: MIT
*
*/

#include "definitions.h"
#include "keys_fr_swiss.h"
#include "macros.dtsi"
#include "combos.dtsi"

/ {
    // #define SYMBOL(NAME, SYMBOLS) \
    //     NAME: NAME { \
    //         compatible = "zmk,behavior-macro"; \
    //         #binding-cells = <0>; \
    //         wait-ms = <0>; \
    //         tap-ms = <0>; \
    //         bindings = <&macro_tap SYMBOLS>; \
    //     };

    #define ALTGRSYMBOL(NAME, SYMBOLS) \
        NAME: NAME { \
            compatible = "zmk,behavior-macro"; \
            #binding-cells = <0>; \
            wait-ms = <0>; \
            tap-ms = <0>; \
            bindings \
                = <&macro_release &kp RALT> \
                , <&macro_tap SYMBOLS> \
                , <&macro_press &kp RALT>; \
        };

    #define MODMORPH_SHIFT(NAME, UNSHIFTED, SHIFTED) \
        NAME: NAME { \
            compatible = "zmk,behavior-mod-morph"; \
            #binding-cells = <0>; \
            bindings = <UNSHIFTED>, <SHIFTED>; \
            mods = <(MOD_LSFT|MOD_RSFT)>; \
        };

    #define MODMORPH_ALTGR(NAME, DEFAULT, ALTGRED) \
        NAME: NAME { \
            compatible = "zmk,behavior-mod-morph"; \
            #binding-cells = <0>; \
            bindings = <DEFAULT>, <ALTGRED>; \
            mods = <(MOD_RALT)>; \
        };

    #define TAPHOLD_SYMBOL(NAME, TAP, HOLD) \
        NAME: NAME { \
            compatible = "zmk,behavior-hold-tap"; \
            #binding-cells = <2>; \
            tapping-term-ms = <250>; \
            flavor = "tap-preferred"; \
            bindings = <HOLD>, <TAP>; \
            quick-tap-ms = <50>; \
        };
        // require-prior-idle-ms = <50>; \

    #define MODTAP_SYMBOL(NAME, BINDINGS) \
        NAME: NAME { \
            compatible = "zmk,behavior-hold-tap"; \
            #binding-cells = <2>; \
            tapping-term-ms = <250>; \
            flavor = "tap-preferred"; \
            bindings = <&kp>, <BINDINGS>; \
            quick-tap-ms = <50>; \
        };
        // require-prior-idle-ms = <50>; \

    // Used for DeadKey with sticky layer
    #define STICKLAYERTAP_SYMBOL(NAME, BINDINGS) \
        NAME: NAME { \
            compatible = "zmk,behavior-hold-tap"; \
            #binding-cells = <2>; \
            tapping-term-ms = <250>; \
            flavor = "tap-preferred"; \
            bindings = <&sl>, <BINDINGS>; \
        };

    // #define LAYERTAP_SYMBOL(NAME, BINDINGS) \
    //     NAME: NAME { \
    //         compatible = "zmk,behavior-hold-tap"; \
    //         #binding-cells = <2>; \
    //         tapping-term-ms = <250>; \
    //         flavor = "tap-preferred"; \
    //         bindings = <&lt>, <BINDINGS>; \
    //     };

    #define MACRO_SYMBOL(NAME, SYMBOLS) \
        NAME: NAME { \
            compatible = "zmk,behavior-macro"; \
            #binding-cells = <0>; \
            wait-ms = <10>; \
            tap-ms = <10>; \
            bindings = <&macro_release &kp RALT>, <&macro_tap SYMBOLS>, <&macro_press &kp RALT>; \
        };

    // #define TAPDANCE_SYMBOL(NAME, TAPHOLD, DTAP, TTAP) \
    //     NAME: NAME { \
    //         compatible = "zmk,behavior-tap-dance"; \
    //         #binding-cells = <0>; \
    //         tapping-term-ms = <TD_TAPPING_TERM>; \
    //         bindings = <TAPHOLD>, <DTAP>, <TTAP>; \
    //     };

    behaviors {
        /* D^ £ D¨ D` ° & ' */
        ALTGRSYMBOL(agsy_caretdk, &kp CH_CARET_DK)
        ALTGRSYMBOL(agsy_pound, &kp CH_POUND_SIGN)
        ALTGRSYMBOL(agsy_umlautdk, &kp CH_UMLAUT_DK)
        ALTGRSYMBOL(agsy_gravedk, &kp CH_GRAVE_DK)
        ALTGRSYMBOL(agsy_deg, &kp CH_DEG)
        ALTGRSYMBOL(agsy_amps, &kp CH_AMPS)
        ALTGRSYMBOL(agsy_apos, &kp CH_APOS)

        /* à | À */
        MODMORPH_SHIFT(sh_agrv, &kp CH_A_GRAVE, &mcr_shft_a_grv)
        MODTAP_SYMBOL(mt_agrv, &sh_agrv)
        /* â | Â */
        MODMORPH_SHIFT(sh_acar, &mcr_a_car, &mcr_shft_a_car)
        /* ç | Ç */
        MODMORPH_SHIFT(sh_cced, &kp CH_C_CEDILLA, &kp CH_C_CEDILLA_SHFTED)
        /* è | È */
        MODMORPH_SHIFT(sh_egrv, &kp CH_E_GRAVE, &mcr_shft_e_grv)
        MODTAP_SYMBOL(mt_egrv, &sh_egrv)
        /* é | É */
        MODMORPH_SHIFT(sh_eacu, &kp CH_E_ACUTE, &mcr_shft_e_acu)
        MODTAP_SYMBOL(mt_eacu, &sh_eacu)
        /* ê | Ê */
        MODMORPH_SHIFT(sh_ecar, &mcr_e_car, &mcr_shft_e_car)
        MODTAP_SYMBOL(mt_ecar, &sh_ecar)
        /* î | Î */
        MODMORPH_SHIFT(sh_icar, &mcr_i_car, &mcr_shft_i_car)
        MODTAP_SYMBOL(mt_icar, &sh_icar)
        /* ï | Ï */
        MODMORPH_SHIFT(sh_iumlt, &mcr_i_umlt, &mcr_shft_i_umlt)
        MODTAP_SYMBOL(mt_iumlt, &sh_iumlt)
        /* ô | Ô */
        MODMORPH_SHIFT(sh_ocar, &mcr_o_car, &mcr_shft_o_car)
        /* ù | Ù */
        MODMORPH_SHIFT(sh_ugrv, &mcr_u_grv, &mcr_shft_u_grv)
        MODTAP_SYMBOL(mt_ugrv, &sh_ugrv)
        /* û | Û */
        MODMORPH_SHIFT(sh_ucar, &mcr_u_car, &mcr_shft_u_car)
        /* ñ | Ñ */
        MODMORPH_SHIFT(sh_ntld, &mcr_n_tld, &mcr_shft_n_tld)
        /* ? | ¿ */
        MODMORPH_SHIFT(sh_qmark, &kp CH_QMARK, &kp CH_QMARK_INV)
        /* ! | ¡ */
        MODMORPH_SHIFT(sh_excl, &kp CH_EXCL, &kp CH_EXCL_INV)
        MODTAP_SYMBOL(mt_excl, &sh_excl)
        /* _ | – */
        MODMORPH_SHIFT(sh_under, &kp CH_UNDER, &kp CH_EM_DASH)
        /* · | • */
        MODMORPH_SHIFT(sh_mdot, &kp CH_MDOT, &kp CH_BULLET)
        /* ^ | D^*/
        MODMORPH_SHIFT(sh_caret, &mcr_caret, &agsy_caretdk)
        /* < | ≤ */
        MODMORPH_SHIFT(sh_less, &kp CH_LT, &kp CH_LET)
        /* > | ≥ */
        MODMORPH_SHIFT(sh_grtr, &kp CH_GT, &kp CH_GET)
        /* $ | £ */
        MODMORPH_SHIFT(sh_dollar, &kp CH_DOLLAR, &agsy_pound)
        /* % | ‰ */
        MODMORPH_SHIFT(sh_prcnt, &kp CH_PRCNT, &kp CH_PRMLL)
        /* ¨ | D¨ */
        MODMORPH_SHIFT(sh_umlaut, &mcr_umlaut, &agsy_umlautdk)
        /* = | ≠ */
        MODMORPH_SHIFT(sh_equal, &kp CH_EQUAL, &kp CH_NEQUAL)
        /* * | · */
        MODMORPH_SHIFT(sh_times, &kp CH_ASTRK, &kp CH_MDOT)
        /* ´ | D´ */
        MODMORPH_SHIFT(sh_acute, &mcr_acute, &kp CH_ACUTE_DK)
        /* ` | D` */
        MODMORPH_SHIFT(sh_grave, &mcr_grave, &agsy_gravedk)
        /* { | ° */
        MODMORPH_SHIFT(sh_lbrace, &kp CH_LBRC, &agsy_deg)
        MODTAP_SYMBOL(mt_lbrace, &sh_lbrace)
        /* ( | “ */
        MODMORPH_SHIFT(sh_lpar, &kp CH_LPAR, &kp CH_LDQM)
        MODTAP_SYMBOL(mt_lpar, &sh_lpar)
        /* ) | ” */
        MODMORPH_SHIFT(sh_rpar, &kp CH_RPAR, &kp CH_RDQM)
        MODTAP_SYMBOL(mt_rpar, &sh_rpar)
        /* } | € */
        MODMORPH_SHIFT(sh_rbrace, &kp CH_RBRC, &kp CH_EURO)
        MODTAP_SYMBOL(mt_rbrace, &sh_rbrace)
        /* + | ± */
        MODMORPH_SHIFT(sh_plus, &kp CH_PLUS, &kp CH_PLUS_MINUS)
        MODTAP_SYMBOL(mt_plus, &sh_plus)
        /* - | ¯ */
        MODMORPH_SHIFT(sh_minus, &kp CH_MINUS, &kp CH_MACRON)
        MODTAP_SYMBOL(mt_minus, &sh_minus)
        /* / | ÷ */
        MODMORPH_SHIFT(sh_slash, &kp CH_SLASH, &kp CH_DIVISION)
        MODTAP_SYMBOL(mt_slash, &sh_slash)
        /* " | @ */
        MODMORPH_SHIFT(sh_dquotes, &kp CH_DQT, &kp CH_AT)
        MODTAP_SYMBOL(mt_dquotes, &sh_dquotes)
        /* | | & */
        MODMORPH_SHIFT(sh_pipe, &kp CH_PIPE, &agsy_amps)
        /* ! | ¬ */
        MODMORPH_SHIFT(sh_excl_not, &kp CH_EXCL, &kp CH_NOT)
        /* ? | ' */
        MODMORPH_SHIFT(sh_qmark_apos, &kp CH_QMARK , &agsy_apos)
        /* [ | « */
        MODMORPH_SHIFT(sh_lbkt, &kp CH_LBKT, &kp CH_LGMT)
        /* ] | » */
        MODMORPH_SHIFT(sh_rbkt, &kp CH_RBKT, &kp CH_RGMT)
        /* ~ | D~ */
        MODMORPH_SHIFT(sh_tilde, &mcr_tilde, &kp CH_TILDE_DK)
        /* Δ | Σ */
        MODMORPH_SHIFT(sh_delta, &kp CH_DELTA, &kp CH_SIGMA)
        /* π | Π */
        MODMORPH_SHIFT(sh_pi, &kp CH_PI, &kp CH_PI_SHIFTED)
        /* 1 | ƒ */
        MODMORPH_SHIFT(sh_one, &kp CH_N1, &kp CH_FUNCTION)
        /* 2 | √ */
        MODMORPH_SHIFT(sh_two, &kp CH_N2, &kp CH_RADICAL)
        /* 3 | ∫ */
        MODMORPH_SHIFT(sh_three, &kp CH_N3, &kp CH_INTEGRAL)
        /* 4 | + */
        MODMORPH_SHIFT(sh_four, &kp CH_N4, &kp CH_PLUS)
        MODTAP_SYMBOL(mt_four, &sh_four)
        /* 5 | - */
        MODMORPH_SHIFT(sh_five, &kp CH_N5, &kp CH_MINUS)
        MODTAP_SYMBOL(mt_five, &sh_five)
        /* 6 | / */
        MODMORPH_SHIFT(sh_six, &kp CH_N6, &kp CH_SLASH)
        MODTAP_SYMBOL(mt_six, &sh_six)
        /* 7 | = */
        MODMORPH_SHIFT(sh_seven, &kp CH_N7, &kp CH_EQUAL)
        /* 8 | * */
        MODMORPH_SHIFT(sh_eight, &kp CH_N8, &kp CH_ASTRK)
        /* 9 | ∞ */
        MODMORPH_SHIFT(sh_nine, &kp CH_N9, &kp CH_INFINITY)
        /* 0 | 0 */
        MODMORPH_SHIFT(sh_zero, &kp CH_N0, &kp CH_N0)
        MODTAP_SYMBOL(mt_zero, &sh_zero)
        /* . | , */
        MODMORPH_SHIFT(sh_dot, &kp CH_DOT, &kp CH_COMMA)
        MODTAP_SYMBOL(mt_dot, &sh_dot)

        MODMORPH_ALTGR(kp_q, &kp CH_Q, &sh_caret)
        MODMORPH_ALTGR(kp_c, &kp CH_C, &sh_less)
        STICKLAYERTAP_SYMBOL(dk_c, &kp_c)
        MODMORPH_ALTGR(kp_o, &kp CH_O, &sh_grtr)
        MODMORPH_ALTGR(kp_p, &kp CH_P, &sh_dollar)
        MODMORPH_ALTGR(kp_w, &kp CH_W, &sh_prcnt)
        MODMORPH_ALTGR(kp_j, &kp CH_J, &sh_umlaut)
        MODMORPH_ALTGR(kp_m, &kp CH_M, &sh_equal)
        MODMORPH_ALTGR(kp_d, &kp CH_D, &sh_times)
        MODMORPH_ALTGR(kp_f, &kp CH_F, &sh_acute)
        STICKLAYERTAP_SYMBOL(dk_f, &kp_f)
        MODMORPH_ALTGR(kp_y, &kp CH_Y, &sh_grave)
        MODMORPH_ALTGR(kp_a, &kp CH_A, &sh_lbrace)
        MODTAP_SYMBOL(md_a, &kp_a)
        MODMORPH_ALTGR(kp_s, &kp CH_S, &sh_lpar)
        MODTAP_SYMBOL(md_s, &kp_s)
        MODMORPH_ALTGR(kp_e, &kp CH_E, &sh_rpar)
        MODTAP_SYMBOL(md_e, &kp_e)
        MODMORPH_ALTGR(kp_n, &kp CH_N, &sh_rbrace)
        MODTAP_SYMBOL(md_n, &kp_n)
        MODMORPH_ALTGR(kp_b, &kp CH_B, &kp CH_HASH)
        MODMORPH_ALTGR(kp_l, &kp CH_L, &kp CH_BSLH)
        MODMORPH_ALTGR(kp_r, &kp CH_R, &sh_plus)
        MODTAP_SYMBOL(md_r, &kp_r)
        MODMORPH_ALTGR(kp_t, &kp CH_T, &sh_minus)
        MODTAP_SYMBOL(md_t, &kp_t)
        MODMORPH_ALTGR(kp_i, &kp CH_I, &sh_slash)
        MODTAP_SYMBOL(md_i, &kp_i)
        MODMORPH_ALTGR(kp_u, &kp CH_U, &sh_dquotes)
        MODTAP_SYMBOL(md_u, &kp_u)
        MODMORPH_ALTGR(kp_x, &kp CH_X, &sh_lbkt)
        MODMORPH_ALTGR(kp_z, &kp CH_Z, &sh_rbkt)
        MODMORPH_ALTGR(kp_v, &kp CH_V, &sh_tilde)
        MODMORPH_ALTGR(kp_h, &kp CH_H, &sh_pipe)
        MODMORPH_ALTGR(kp_g, &kp CH_G, &sh_excl_not)
        MODMORPH_ALTGR(kp_k, &kp CH_K, &sh_qmark_apos)
        // MODMORPH_ALTGR(kp_spc, &kp SPACE, &kp CH_APOS)
        // LAYERTAP_SYMBOL(lt_spc, &kp SPACE)
        // LAYERTAP_SYMBOL(lt_apos, &kp CH_APOS)

    };
};