/*
*
* Copyright (c) 2025 Daniel Suter
* SPDX-License-Identifier: MIT
*
*/

#include "definitions.h"
#include "keys_fr_swiss.h"

/ {
    #define COMBO(NAME, KEYS, BINDINGS, LAYERS, COMBO_TERM) \
        NAME { \
            timeout-ms = <COMBO_TERM>; \
            layers = <LAYERS>; \
            key-positions = <KEYS>; \
            bindings = <BINDINGS>; \
        };
    combos {
        compatible = "zmk,combos";
        COMBO(cb_esc_l, LHP LHR, &mt LS(LGUI) ESC, ALP_L ACC_L NAV_L, CMB_SHORT)
        COMBO(cb_esc_r, RHP RHR, &mt LS(LGUI) ESC, ALP_L ACC_L NAV_L, CMB_DEF)
        COMBO(cb_tab_l, LHR LHM, &mt LC(LGUI) TAB, ALP_L ACC_L NAV_L, CMB_DEF)
        COMBO(cb_tab_r, RHR RHM, &mt LC(LGUI) TAB, ALP_L ACC_L NAV_L, CMB_SHORT)
        COMBO(cb_enter_l, LHM LHI, &mt LC(LALT) RET, ALP_L ACC_L NAV_L, CMB_DEF)
        COMBO(cb_enter_r, RHM RHI, &mt LC(LALT) RET, ALP_L ACC_L NAV_L, CMB_DEF)
        COMBO(cb_capslock, LT0 RT0, &kp CAPS, ALP_L ACC_L NAV_L, CMB_SHORT)
        COMBO(cb_dot, RBI RBM, &kp CH_DOT, ALP_L ACC_L, CMB_DEF)
        COMBO(cb_comma, RBM RBR, &kp CH_COMMA, ALP_L ACC_L, CMB_DEF)
        COMBO(cb_minus, LBR LBM, &kp CH_MINUS, ALP_L ACC_L, CMB_DEF)
    };

/*
    // #define COMBO_TERM 50
    #define DEF 50
    #define SHORT 30

    #define COMBO(NAME, KEYS, BINDINGS, LAYERS, COMBO_TERM) \
        NAME { \
            timeout-ms = <COMBO_TERM>; \
            layers = <LAYERS>; \
            key-positions = <KEYS>; \
            bindings = <BINDINGS>; \
        };

    combos {
        compatible = "zmk,combos";
        COMBO(cb_q,             LHR LHM,     &ht_q 0 0,          ALPHA1 SEN_CASE)
    };
*/
/*
    #define COMBO_MUST_TAP(NAME, HOLD, TAP) \
        NAME##hold: NAME##hold { \
            compatible = "zmk,behavior-macro"; \
            label = ZMK_MACRO_STRINGIFY(NAME##hold); \
            #binding-cells = <0>; \
            wait-ms = <0>; \
            tap-ms = <0>; \
            bindings \
                = <&macro_press HOLD> \
                , <&macro_pause_for_release> \
                , <&macro_release HOLD> \
                ; \
        }; \
        NAME##tap: NAME##tap {  \
            compatible = "zmk,behavior-macro";  \
            label = ZMK_MACRO_STRINGIFY(NAME##tap); \
            #binding-cells = <0>; \
            wait-ms = <0>; \
            tap-ms = <0>; \
            bindings = <&macro_tap TAP>; \
        }; \
        NAME: NAME { \
            compatible = "zmk,behavior-hold-tap"; \
            label = ZMK_MACRO_STRINGIFY(NAME); \
            #binding-cells = <2>; \
            tapping-term-ms = <TAPPING_TERM>; \
            flavor = "hold-preferred"; \
            bindings = <&NAME##hold>, <&NAME##tap>; \
        };

    combo_must_tap {

        COMBO_MUST_TAP(ht_w     , &kp LCTL  &kp LGUI                   , &kp W)

    };
*/
};